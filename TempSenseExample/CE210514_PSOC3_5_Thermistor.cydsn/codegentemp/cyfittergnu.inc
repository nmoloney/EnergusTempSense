.ifndef INCLUDED_CYFITTERGNU_INC
.set INCLUDED_CYFITTERGNU_INC, 1
.include "cydevicegnu.inc"
.include "cydevicegnu_trm.inc"

/* TX */
.set TX__0__INTTYPE, CYREG_PICU12_INTTYPE7
.set TX__0__MASK, 0x80
.set TX__0__PC, CYREG_PRT12_PC7
.set TX__0__PORT, 12
.set TX__0__SHIFT, 7
.set TX__AG, CYREG_PRT12_AG
.set TX__BIE, CYREG_PRT12_BIE
.set TX__BIT_MASK, CYREG_PRT12_BIT_MASK
.set TX__BYP, CYREG_PRT12_BYP
.set TX__DM0, CYREG_PRT12_DM0
.set TX__DM1, CYREG_PRT12_DM1
.set TX__DM2, CYREG_PRT12_DM2
.set TX__DR, CYREG_PRT12_DR
.set TX__INP_DIS, CYREG_PRT12_INP_DIS
.set TX__INTTYPE_BASE, CYDEV_PICU_INTTYPE_PICU12_BASE
.set TX__MASK, 0x80
.set TX__PORT, 12
.set TX__PRT, CYREG_PRT12_PRT
.set TX__PRTDSI__DBL_SYNC_IN, CYREG_PRT12_DBL_SYNC_IN
.set TX__PRTDSI__OE_SEL0, CYREG_PRT12_OE_SEL0
.set TX__PRTDSI__OE_SEL1, CYREG_PRT12_OE_SEL1
.set TX__PRTDSI__OUT_SEL0, CYREG_PRT12_OUT_SEL0
.set TX__PRTDSI__OUT_SEL1, CYREG_PRT12_OUT_SEL1
.set TX__PRTDSI__SYNC_OUT, CYREG_PRT12_SYNC_OUT
.set TX__PS, CYREG_PRT12_PS
.set TX__SHIFT, 7
.set TX__SIO_CFG, CYREG_PRT12_SIO_CFG
.set TX__SIO_DIFF, CYREG_PRT12_SIO_DIFF
.set TX__SIO_HYST_EN, CYREG_PRT12_SIO_HYST_EN
.set TX__SIO_REG_HIFREQ, CYREG_PRT12_SIO_REG_HIFREQ
.set TX__SLW, CYREG_PRT12_SLW

/* ADC_DEC */
.set ADC_DEC__COHER, CYREG_DEC_COHER
.set ADC_DEC__CR, CYREG_DEC_CR
.set ADC_DEC__DR1, CYREG_DEC_DR1
.set ADC_DEC__DR2, CYREG_DEC_DR2
.set ADC_DEC__DR2H, CYREG_DEC_DR2H
.set ADC_DEC__GCOR, CYREG_DEC_GCOR
.set ADC_DEC__GCORH, CYREG_DEC_GCORH
.set ADC_DEC__GVAL, CYREG_DEC_GVAL
.set ADC_DEC__OCOR, CYREG_DEC_OCOR
.set ADC_DEC__OCORH, CYREG_DEC_OCORH
.set ADC_DEC__OCORM, CYREG_DEC_OCORM
.set ADC_DEC__OUTSAMP, CYREG_DEC_OUTSAMP
.set ADC_DEC__OUTSAMPH, CYREG_DEC_OUTSAMPH
.set ADC_DEC__OUTSAMPM, CYREG_DEC_OUTSAMPM
.set ADC_DEC__OUTSAMPS, CYREG_DEC_OUTSAMPS
.set ADC_DEC__PM_ACT_CFG, CYREG_PM_ACT_CFG10
.set ADC_DEC__PM_ACT_MSK, 0x01
.set ADC_DEC__PM_STBY_CFG, CYREG_PM_STBY_CFG10
.set ADC_DEC__PM_STBY_MSK, 0x01
.set ADC_DEC__SHIFT1, CYREG_DEC_SHIFT1
.set ADC_DEC__SHIFT2, CYREG_DEC_SHIFT2
.set ADC_DEC__SR, CYREG_DEC_SR
.set ADC_DEC__TRIM__M1, CYREG_FLSHID_CUST_TABLES_DEC_M1
.set ADC_DEC__TRIM__M2, CYREG_FLSHID_CUST_TABLES_DEC_M2
.set ADC_DEC__TRIM__M3, CYREG_FLSHID_CUST_TABLES_DEC_M3
.set ADC_DEC__TRIM__M4, CYREG_FLSHID_CUST_TABLES_DEC_M4
.set ADC_DEC__TRIM__M5, CYREG_FLSHID_CUST_TABLES_DEC_M5
.set ADC_DEC__TRIM__M6, CYREG_FLSHID_CUST_TABLES_DEC_M6
.set ADC_DEC__TRIM__M7, CYREG_FLSHID_CUST_TABLES_DEC_M7
.set ADC_DEC__TRIM__M8, CYREG_FLSHID_CUST_TABLES_DEC_M8

/* ADC_DSM */
.set ADC_DSM__BUF0, CYREG_DSM0_BUF0
.set ADC_DSM__BUF1, CYREG_DSM0_BUF1
.set ADC_DSM__BUF2, CYREG_DSM0_BUF2
.set ADC_DSM__BUF3, CYREG_DSM0_BUF3
.set ADC_DSM__CLK, CYREG_DSM0_CLK
.set ADC_DSM__CR0, CYREG_DSM0_CR0
.set ADC_DSM__CR1, CYREG_DSM0_CR1
.set ADC_DSM__CR10, CYREG_DSM0_CR10
.set ADC_DSM__CR11, CYREG_DSM0_CR11
.set ADC_DSM__CR12, CYREG_DSM0_CR12
.set ADC_DSM__CR13, CYREG_DSM0_CR13
.set ADC_DSM__CR14, CYREG_DSM0_CR14
.set ADC_DSM__CR15, CYREG_DSM0_CR15
.set ADC_DSM__CR16, CYREG_DSM0_CR16
.set ADC_DSM__CR17, CYREG_DSM0_CR17
.set ADC_DSM__CR2, CYREG_DSM0_CR2
.set ADC_DSM__CR3, CYREG_DSM0_CR3
.set ADC_DSM__CR4, CYREG_DSM0_CR4
.set ADC_DSM__CR5, CYREG_DSM0_CR5
.set ADC_DSM__CR6, CYREG_DSM0_CR6
.set ADC_DSM__CR7, CYREG_DSM0_CR7
.set ADC_DSM__CR8, CYREG_DSM0_CR8
.set ADC_DSM__CR9, CYREG_DSM0_CR9
.set ADC_DSM__DEM0, CYREG_DSM0_DEM0
.set ADC_DSM__DEM1, CYREG_DSM0_DEM1
.set ADC_DSM__MISC, CYREG_DSM0_MISC
.set ADC_DSM__OUT0, CYREG_DSM0_OUT0
.set ADC_DSM__OUT1, CYREG_DSM0_OUT1
.set ADC_DSM__REF0, CYREG_DSM0_REF0
.set ADC_DSM__REF1, CYREG_DSM0_REF1
.set ADC_DSM__REF2, CYREG_DSM0_REF2
.set ADC_DSM__REF3, CYREG_DSM0_REF3
.set ADC_DSM__RSVD1, CYREG_DSM0_RSVD1
.set ADC_DSM__SW0, CYREG_DSM0_SW0
.set ADC_DSM__SW2, CYREG_DSM0_SW2
.set ADC_DSM__SW3, CYREG_DSM0_SW3
.set ADC_DSM__SW4, CYREG_DSM0_SW4
.set ADC_DSM__SW6, CYREG_DSM0_SW6
.set ADC_DSM__TR0, CYREG_NPUMP_DSM_TR0
.set ADC_DSM__TST0, CYREG_DSM0_TST0
.set ADC_DSM__TST1, CYREG_DSM0_TST1

/* ADC_Ext_CP_Clk */
.set ADC_Ext_CP_Clk__CFG0, CYREG_CLKDIST_DCFG0_CFG0
.set ADC_Ext_CP_Clk__CFG1, CYREG_CLKDIST_DCFG0_CFG1
.set ADC_Ext_CP_Clk__CFG2, CYREG_CLKDIST_DCFG0_CFG2
.set ADC_Ext_CP_Clk__CFG2_SRC_SEL_MASK, 0x07
.set ADC_Ext_CP_Clk__INDEX, 0x00
.set ADC_Ext_CP_Clk__PM_ACT_CFG, CYREG_PM_ACT_CFG2
.set ADC_Ext_CP_Clk__PM_ACT_MSK, 0x01
.set ADC_Ext_CP_Clk__PM_STBY_CFG, CYREG_PM_STBY_CFG2
.set ADC_Ext_CP_Clk__PM_STBY_MSK, 0x01

/* ADC_IRQ */
.set ADC_IRQ__INTC_CLR_EN_REG, CYREG_NVIC_CLRENA0
.set ADC_IRQ__INTC_CLR_PD_REG, CYREG_NVIC_CLRPEND0
.set ADC_IRQ__INTC_MASK, 0x20000000
.set ADC_IRQ__INTC_NUMBER, 29
.set ADC_IRQ__INTC_PRIOR_NUM, 7
.set ADC_IRQ__INTC_PRIOR_REG, CYREG_NVIC_PRI_29
.set ADC_IRQ__INTC_SET_EN_REG, CYREG_NVIC_SETENA0
.set ADC_IRQ__INTC_SET_PD_REG, CYREG_NVIC_SETPEND0

/* ADC_theACLK */
.set ADC_theACLK__CFG0, CYREG_CLKDIST_ACFG0_CFG0
.set ADC_theACLK__CFG1, CYREG_CLKDIST_ACFG0_CFG1
.set ADC_theACLK__CFG2, CYREG_CLKDIST_ACFG0_CFG2
.set ADC_theACLK__CFG2_SRC_SEL_MASK, 0x07
.set ADC_theACLK__CFG3, CYREG_CLKDIST_ACFG0_CFG3
.set ADC_theACLK__CFG3_PHASE_DLY_MASK, 0x0F
.set ADC_theACLK__INDEX, 0x00
.set ADC_theACLK__PM_ACT_CFG, CYREG_PM_ACT_CFG1
.set ADC_theACLK__PM_ACT_MSK, 0x01
.set ADC_theACLK__PM_STBY_CFG, CYREG_PM_STBY_CFG1
.set ADC_theACLK__PM_STBY_MSK, 0x01

/* Vhi */
.set Vhi__0__INTTYPE, CYREG_PICU0_INTTYPE0
.set Vhi__0__MASK, 0x01
.set Vhi__0__PC, CYREG_PRT0_PC0
.set Vhi__0__PORT, 0
.set Vhi__0__SHIFT, 0
.set Vhi__AG, CYREG_PRT0_AG
.set Vhi__AMUX, CYREG_PRT0_AMUX
.set Vhi__BIE, CYREG_PRT0_BIE
.set Vhi__BIT_MASK, CYREG_PRT0_BIT_MASK
.set Vhi__BYP, CYREG_PRT0_BYP
.set Vhi__CTL, CYREG_PRT0_CTL
.set Vhi__DM0, CYREG_PRT0_DM0
.set Vhi__DM1, CYREG_PRT0_DM1
.set Vhi__DM2, CYREG_PRT0_DM2
.set Vhi__DR, CYREG_PRT0_DR
.set Vhi__INP_DIS, CYREG_PRT0_INP_DIS
.set Vhi__INTTYPE_BASE, CYDEV_PICU_INTTYPE_PICU0_BASE
.set Vhi__LCD_COM_SEG, CYREG_PRT0_LCD_COM_SEG
.set Vhi__LCD_EN, CYREG_PRT0_LCD_EN
.set Vhi__MASK, 0x01
.set Vhi__PORT, 0
.set Vhi__PRT, CYREG_PRT0_PRT
.set Vhi__PRTDSI__CAPS_SEL, CYREG_PRT0_CAPS_SEL
.set Vhi__PRTDSI__DBL_SYNC_IN, CYREG_PRT0_DBL_SYNC_IN
.set Vhi__PRTDSI__OE_SEL0, CYREG_PRT0_OE_SEL0
.set Vhi__PRTDSI__OE_SEL1, CYREG_PRT0_OE_SEL1
.set Vhi__PRTDSI__OUT_SEL0, CYREG_PRT0_OUT_SEL0
.set Vhi__PRTDSI__OUT_SEL1, CYREG_PRT0_OUT_SEL1
.set Vhi__PRTDSI__SYNC_OUT, CYREG_PRT0_SYNC_OUT
.set Vhi__PS, CYREG_PRT0_PS
.set Vhi__SHIFT, 0
.set Vhi__SLW, CYREG_PRT0_SLW

/* UART_BUART */
.set UART_BUART_sTX_sCLOCK_TxBitClkGen__16BIT_A0_REG, CYREG_B1_UDB10_11_A0
.set UART_BUART_sTX_sCLOCK_TxBitClkGen__16BIT_A1_REG, CYREG_B1_UDB10_11_A1
.set UART_BUART_sTX_sCLOCK_TxBitClkGen__16BIT_D0_REG, CYREG_B1_UDB10_11_D0
.set UART_BUART_sTX_sCLOCK_TxBitClkGen__16BIT_D1_REG, CYREG_B1_UDB10_11_D1
.set UART_BUART_sTX_sCLOCK_TxBitClkGen__16BIT_DP_AUX_CTL_REG, CYREG_B1_UDB10_11_ACTL
.set UART_BUART_sTX_sCLOCK_TxBitClkGen__16BIT_F0_REG, CYREG_B1_UDB10_11_F0
.set UART_BUART_sTX_sCLOCK_TxBitClkGen__16BIT_F1_REG, CYREG_B1_UDB10_11_F1
.set UART_BUART_sTX_sCLOCK_TxBitClkGen__A0_A1_REG, CYREG_B1_UDB10_A0_A1
.set UART_BUART_sTX_sCLOCK_TxBitClkGen__A0_REG, CYREG_B1_UDB10_A0
.set UART_BUART_sTX_sCLOCK_TxBitClkGen__A1_REG, CYREG_B1_UDB10_A1
.set UART_BUART_sTX_sCLOCK_TxBitClkGen__D0_D1_REG, CYREG_B1_UDB10_D0_D1
.set UART_BUART_sTX_sCLOCK_TxBitClkGen__D0_REG, CYREG_B1_UDB10_D0
.set UART_BUART_sTX_sCLOCK_TxBitClkGen__D1_REG, CYREG_B1_UDB10_D1
.set UART_BUART_sTX_sCLOCK_TxBitClkGen__DP_AUX_CTL_REG, CYREG_B1_UDB10_ACTL
.set UART_BUART_sTX_sCLOCK_TxBitClkGen__F0_F1_REG, CYREG_B1_UDB10_F0_F1
.set UART_BUART_sTX_sCLOCK_TxBitClkGen__F0_REG, CYREG_B1_UDB10_F0
.set UART_BUART_sTX_sCLOCK_TxBitClkGen__F1_REG, CYREG_B1_UDB10_F1
.set UART_BUART_sTX_TxShifter_u0__A0_A1_REG, CYREG_B1_UDB11_A0_A1
.set UART_BUART_sTX_TxShifter_u0__A0_REG, CYREG_B1_UDB11_A0
.set UART_BUART_sTX_TxShifter_u0__A1_REG, CYREG_B1_UDB11_A1
.set UART_BUART_sTX_TxShifter_u0__D0_D1_REG, CYREG_B1_UDB11_D0_D1
.set UART_BUART_sTX_TxShifter_u0__D0_REG, CYREG_B1_UDB11_D0
.set UART_BUART_sTX_TxShifter_u0__D1_REG, CYREG_B1_UDB11_D1
.set UART_BUART_sTX_TxShifter_u0__DP_AUX_CTL_REG, CYREG_B1_UDB11_ACTL
.set UART_BUART_sTX_TxShifter_u0__F0_F1_REG, CYREG_B1_UDB11_F0_F1
.set UART_BUART_sTX_TxShifter_u0__F0_REG, CYREG_B1_UDB11_F0
.set UART_BUART_sTX_TxShifter_u0__F1_REG, CYREG_B1_UDB11_F1
.set UART_BUART_sTX_TxSts__0__MASK, 0x01
.set UART_BUART_sTX_TxSts__0__POS, 0
.set UART_BUART_sTX_TxSts__1__MASK, 0x02
.set UART_BUART_sTX_TxSts__1__POS, 1
.set UART_BUART_sTX_TxSts__2__MASK, 0x04
.set UART_BUART_sTX_TxSts__2__POS, 2
.set UART_BUART_sTX_TxSts__3__MASK, 0x08
.set UART_BUART_sTX_TxSts__3__POS, 3
.set UART_BUART_sTX_TxSts__MASK, 0x0F
.set UART_BUART_sTX_TxSts__MASK_REG, CYREG_B1_UDB11_MSK
.set UART_BUART_sTX_TxSts__STATUS_AUX_CTL_REG, CYREG_B1_UDB11_ACTL
.set UART_BUART_sTX_TxSts__STATUS_REG, CYREG_B1_UDB11_ST

/* UART_IntClock */
.set UART_IntClock__CFG0, CYREG_CLKDIST_DCFG1_CFG0
.set UART_IntClock__CFG1, CYREG_CLKDIST_DCFG1_CFG1
.set UART_IntClock__CFG2, CYREG_CLKDIST_DCFG1_CFG2
.set UART_IntClock__CFG2_SRC_SEL_MASK, 0x07
.set UART_IntClock__INDEX, 0x01
.set UART_IntClock__PM_ACT_CFG, CYREG_PM_ACT_CFG2
.set UART_IntClock__PM_ACT_MSK, 0x02
.set UART_IntClock__PM_STBY_CFG, CYREG_PM_STBY_CFG2
.set UART_IntClock__PM_STBY_MSK, 0x02

/* Vlow */
.set Vlow__0__INTTYPE, CYREG_PICU0_INTTYPE2
.set Vlow__0__MASK, 0x04
.set Vlow__0__PC, CYREG_PRT0_PC2
.set Vlow__0__PORT, 0
.set Vlow__0__SHIFT, 2
.set Vlow__AG, CYREG_PRT0_AG
.set Vlow__AMUX, CYREG_PRT0_AMUX
.set Vlow__BIE, CYREG_PRT0_BIE
.set Vlow__BIT_MASK, CYREG_PRT0_BIT_MASK
.set Vlow__BYP, CYREG_PRT0_BYP
.set Vlow__CTL, CYREG_PRT0_CTL
.set Vlow__DM0, CYREG_PRT0_DM0
.set Vlow__DM1, CYREG_PRT0_DM1
.set Vlow__DM2, CYREG_PRT0_DM2
.set Vlow__DR, CYREG_PRT0_DR
.set Vlow__INP_DIS, CYREG_PRT0_INP_DIS
.set Vlow__INTTYPE_BASE, CYDEV_PICU_INTTYPE_PICU0_BASE
.set Vlow__LCD_COM_SEG, CYREG_PRT0_LCD_COM_SEG
.set Vlow__LCD_EN, CYREG_PRT0_LCD_EN
.set Vlow__MASK, 0x04
.set Vlow__PORT, 0
.set Vlow__PRT, CYREG_PRT0_PRT
.set Vlow__PRTDSI__CAPS_SEL, CYREG_PRT0_CAPS_SEL
.set Vlow__PRTDSI__DBL_SYNC_IN, CYREG_PRT0_DBL_SYNC_IN
.set Vlow__PRTDSI__OE_SEL0, CYREG_PRT0_OE_SEL0
.set Vlow__PRTDSI__OE_SEL1, CYREG_PRT0_OE_SEL1
.set Vlow__PRTDSI__OUT_SEL0, CYREG_PRT0_OUT_SEL0
.set Vlow__PRTDSI__OUT_SEL1, CYREG_PRT0_OUT_SEL1
.set Vlow__PRTDSI__SYNC_OUT, CYREG_PRT0_SYNC_OUT
.set Vlow__PS, CYREG_PRT0_PS
.set Vlow__SHIFT, 2
.set Vlow__SLW, CYREG_PRT0_SLW

/* Opamp_ABuf */
.set Opamp_ABuf__CR, CYREG_OPAMP2_CR
.set Opamp_ABuf__MX, CYREG_OPAMP2_MX
.set Opamp_ABuf__NPUMP_OPAMP_TR0, CYREG_NPUMP_OPAMP_TR0
.set Opamp_ABuf__PM_ACT_CFG, CYREG_PM_ACT_CFG4
.set Opamp_ABuf__PM_ACT_MSK, 0x04
.set Opamp_ABuf__PM_STBY_CFG, CYREG_PM_STBY_CFG4
.set Opamp_ABuf__PM_STBY_MSK, 0x04
.set Opamp_ABuf__RSVD, CYREG_OPAMP2_RSVD
.set Opamp_ABuf__SW, CYREG_OPAMP2_SW
.set Opamp_ABuf__TR0, CYREG_OPAMP2_TR0
.set Opamp_ABuf__TR1, CYREG_OPAMP2_TR1

/* VDAC8_viDAC8 */
.set VDAC8_viDAC8__CR0, CYREG_DAC0_CR0
.set VDAC8_viDAC8__CR1, CYREG_DAC0_CR1
.set VDAC8_viDAC8__D, CYREG_DAC0_D
.set VDAC8_viDAC8__PM_ACT_CFG, CYREG_PM_ACT_CFG8
.set VDAC8_viDAC8__PM_ACT_MSK, 0x01
.set VDAC8_viDAC8__PM_STBY_CFG, CYREG_PM_STBY_CFG8
.set VDAC8_viDAC8__PM_STBY_MSK, 0x01
.set VDAC8_viDAC8__STROBE, CYREG_DAC0_STROBE
.set VDAC8_viDAC8__SW0, CYREG_DAC0_SW0
.set VDAC8_viDAC8__SW2, CYREG_DAC0_SW2
.set VDAC8_viDAC8__SW3, CYREG_DAC0_SW3
.set VDAC8_viDAC8__SW4, CYREG_DAC0_SW4
.set VDAC8_viDAC8__TR, CYREG_DAC0_TR
.set VDAC8_viDAC8__TRIM__M1, CYREG_FLSHID_CUST_TABLES_DAC0_M1
.set VDAC8_viDAC8__TRIM__M2, CYREG_FLSHID_CUST_TABLES_DAC0_M2
.set VDAC8_viDAC8__TRIM__M3, CYREG_FLSHID_CUST_TABLES_DAC0_M3
.set VDAC8_viDAC8__TRIM__M4, CYREG_FLSHID_CUST_TABLES_DAC0_M4
.set VDAC8_viDAC8__TRIM__M5, CYREG_FLSHID_CUST_TABLES_DAC0_M5
.set VDAC8_viDAC8__TRIM__M6, CYREG_FLSHID_CUST_TABLES_DAC0_M6
.set VDAC8_viDAC8__TRIM__M7, CYREG_FLSHID_CUST_TABLES_DAC0_M7
.set VDAC8_viDAC8__TRIM__M8, CYREG_FLSHID_CUST_TABLES_DAC0_M8
.set VDAC8_viDAC8__TST, CYREG_DAC0_TST

/* Vtherm */
.set Vtherm__0__INTTYPE, CYREG_PICU0_INTTYPE1
.set Vtherm__0__MASK, 0x02
.set Vtherm__0__PC, CYREG_PRT0_PC1
.set Vtherm__0__PORT, 0
.set Vtherm__0__SHIFT, 1
.set Vtherm__AG, CYREG_PRT0_AG
.set Vtherm__AMUX, CYREG_PRT0_AMUX
.set Vtherm__BIE, CYREG_PRT0_BIE
.set Vtherm__BIT_MASK, CYREG_PRT0_BIT_MASK
.set Vtherm__BYP, CYREG_PRT0_BYP
.set Vtherm__CTL, CYREG_PRT0_CTL
.set Vtherm__DM0, CYREG_PRT0_DM0
.set Vtherm__DM1, CYREG_PRT0_DM1
.set Vtherm__DM2, CYREG_PRT0_DM2
.set Vtherm__DR, CYREG_PRT0_DR
.set Vtherm__INP_DIS, CYREG_PRT0_INP_DIS
.set Vtherm__INTTYPE_BASE, CYDEV_PICU_INTTYPE_PICU0_BASE
.set Vtherm__LCD_COM_SEG, CYREG_PRT0_LCD_COM_SEG
.set Vtherm__LCD_EN, CYREG_PRT0_LCD_EN
.set Vtherm__MASK, 0x02
.set Vtherm__PORT, 0
.set Vtherm__PRT, CYREG_PRT0_PRT
.set Vtherm__PRTDSI__CAPS_SEL, CYREG_PRT0_CAPS_SEL
.set Vtherm__PRTDSI__DBL_SYNC_IN, CYREG_PRT0_DBL_SYNC_IN
.set Vtherm__PRTDSI__OE_SEL0, CYREG_PRT0_OE_SEL0
.set Vtherm__PRTDSI__OE_SEL1, CYREG_PRT0_OE_SEL1
.set Vtherm__PRTDSI__OUT_SEL0, CYREG_PRT0_OUT_SEL0
.set Vtherm__PRTDSI__OUT_SEL1, CYREG_PRT0_OUT_SEL1
.set Vtherm__PRTDSI__SYNC_OUT, CYREG_PRT0_SYNC_OUT
.set Vtherm__PS, CYREG_PRT0_PS
.set Vtherm__SHIFT, 1
.set Vtherm__SLW, CYREG_PRT0_SLW

/* Miscellaneous */
.set BCLK__BUS_CLK__HZ, 24000000
.set BCLK__BUS_CLK__KHZ, 24000
.set BCLK__BUS_CLK__MHZ, 24
.set CYDEV_CHIP_DIE_LEOPARD, 1
.set CYDEV_CHIP_DIE_PANTHER, 18
.set CYDEV_CHIP_DIE_PSOC4A, 10
.set CYDEV_CHIP_DIE_PSOC5LP, 17
.set CYDEV_CHIP_DIE_TMA4, 2
.set CYDEV_CHIP_DIE_UNKNOWN, 0
.set CYDEV_CHIP_FAMILY_PSOC3, 1
.set CYDEV_CHIP_FAMILY_PSOC4, 2
.set CYDEV_CHIP_FAMILY_PSOC5, 3
.set CYDEV_CHIP_FAMILY_UNKNOWN, 0
.set CYDEV_CHIP_FAMILY_USED, CYDEV_CHIP_FAMILY_PSOC5
.set CYDEV_CHIP_JTAG_ID, 0x2E161069
.set CYDEV_CHIP_MEMBER_3A, 1
.set CYDEV_CHIP_MEMBER_4A, 10
.set CYDEV_CHIP_MEMBER_4C, 15
.set CYDEV_CHIP_MEMBER_4D, 6
.set CYDEV_CHIP_MEMBER_4E, 4
.set CYDEV_CHIP_MEMBER_4F, 11
.set CYDEV_CHIP_MEMBER_4G, 2
.set CYDEV_CHIP_MEMBER_4H, 9
.set CYDEV_CHIP_MEMBER_4I, 14
.set CYDEV_CHIP_MEMBER_4J, 7
.set CYDEV_CHIP_MEMBER_4K, 8
.set CYDEV_CHIP_MEMBER_4L, 13
.set CYDEV_CHIP_MEMBER_4M, 12
.set CYDEV_CHIP_MEMBER_4N, 5
.set CYDEV_CHIP_MEMBER_4U, 3
.set CYDEV_CHIP_MEMBER_5A, 17
.set CYDEV_CHIP_MEMBER_5B, 16
.set CYDEV_CHIP_MEMBER_UNKNOWN, 0
.set CYDEV_CHIP_MEMBER_USED, CYDEV_CHIP_MEMBER_5B
.set CYDEV_CHIP_DIE_EXPECT, CYDEV_CHIP_MEMBER_USED
.set CYDEV_CHIP_DIE_ACTUAL, CYDEV_CHIP_DIE_EXPECT
.set CYDEV_CHIP_REV_LEOPARD_ES1, 0
.set CYDEV_CHIP_REV_LEOPARD_ES2, 1
.set CYDEV_CHIP_REV_LEOPARD_ES3, 3
.set CYDEV_CHIP_REV_LEOPARD_PRODUCTION, 3
.set CYDEV_CHIP_REV_PANTHER_ES0, 0
.set CYDEV_CHIP_REV_PANTHER_ES1, 1
.set CYDEV_CHIP_REV_PANTHER_PRODUCTION, 1
.set CYDEV_CHIP_REV_PSOC4A_ES0, 17
.set CYDEV_CHIP_REV_PSOC4A_PRODUCTION, 17
.set CYDEV_CHIP_REV_PSOC5LP_ES0, 0
.set CYDEV_CHIP_REV_PSOC5LP_PRODUCTION, 0
.set CYDEV_CHIP_REV_TMA4_ES, 17
.set CYDEV_CHIP_REV_TMA4_ES2, 33
.set CYDEV_CHIP_REV_TMA4_PRODUCTION, 17
.set CYDEV_CHIP_REVISION_3A_ES1, 0
.set CYDEV_CHIP_REVISION_3A_ES2, 1
.set CYDEV_CHIP_REVISION_3A_ES3, 3
.set CYDEV_CHIP_REVISION_3A_PRODUCTION, 3
.set CYDEV_CHIP_REVISION_4A_ES0, 17
.set CYDEV_CHIP_REVISION_4A_PRODUCTION, 17
.set CYDEV_CHIP_REVISION_4C_PRODUCTION, 0
.set CYDEV_CHIP_REVISION_4D_PRODUCTION, 0
.set CYDEV_CHIP_REVISION_4E_PRODUCTION, 0
.set CYDEV_CHIP_REVISION_4F_PRODUCTION, 0
.set CYDEV_CHIP_REVISION_4F_PRODUCTION_256DMA, 0
.set CYDEV_CHIP_REVISION_4F_PRODUCTION_256K, 0
.set CYDEV_CHIP_REVISION_4G_ES, 17
.set CYDEV_CHIP_REVISION_4G_ES2, 33
.set CYDEV_CHIP_REVISION_4G_PRODUCTION, 17
.set CYDEV_CHIP_REVISION_4H_PRODUCTION, 0
.set CYDEV_CHIP_REVISION_4I_PRODUCTION, 0
.set CYDEV_CHIP_REVISION_4J_PRODUCTION, 0
.set CYDEV_CHIP_REVISION_4K_PRODUCTION, 0
.set CYDEV_CHIP_REVISION_4L_PRODUCTION, 0
.set CYDEV_CHIP_REVISION_4M_PRODUCTION, 0
.set CYDEV_CHIP_REVISION_4N_PRODUCTION, 0
.set CYDEV_CHIP_REVISION_4U_PRODUCTION, 0
.set CYDEV_CHIP_REVISION_5A_ES0, 0
.set CYDEV_CHIP_REVISION_5A_ES1, 1
.set CYDEV_CHIP_REVISION_5A_PRODUCTION, 1
.set CYDEV_CHIP_REVISION_5B_ES0, 0
.set CYDEV_CHIP_REVISION_5B_PRODUCTION, 0
.set CYDEV_CHIP_REVISION_USED, CYDEV_CHIP_REVISION_5B_PRODUCTION
.set CYDEV_CHIP_REV_EXPECT, CYDEV_CHIP_REVISION_USED
.set CYDEV_CONFIG_FASTBOOT_ENABLED, 0
.set CYDEV_CONFIG_UNUSED_IO_AllowButWarn, 0
.set CYDEV_CONFIG_UNUSED_IO_AllowWithInfo, 1
.set CYDEV_CONFIG_UNUSED_IO_Disallowed, 2
.set CYDEV_CONFIG_UNUSED_IO, CYDEV_CONFIG_UNUSED_IO_Disallowed
.set CYDEV_CONFIGURATION_COMPRESSED, 0
.set CYDEV_CONFIGURATION_DMA, 1
.set CYDEV_CONFIGURATION_ECC, 1
.set CYDEV_CONFIGURATION_IMOENABLED, CYDEV_CONFIG_FASTBOOT_ENABLED
.set CYDEV_CONFIGURATION_MODE_COMPRESSED, 0
.set CYDEV_CONFIGURATION_MODE_DMA, 2
.set CYDEV_CONFIGURATION_MODE, CYDEV_CONFIGURATION_MODE_DMA
.set CYDEV_CONFIGURATION_MODE_UNCOMPRESSED, 1
.set CYDEV_DEBUG_ENABLE_MASK, 0x20
.set CYDEV_DEBUG_ENABLE_REGISTER, CYREG_MLOGIC_DEBUG
.set CYDEV_DEBUGGING_DPS_Disable, 3
.set CYDEV_DEBUGGING_DPS_JTAG_4, 1
.set CYDEV_DEBUGGING_DPS_JTAG_5, 0
.set CYDEV_DEBUGGING_DPS_SWD, 2
.set CYDEV_DEBUGGING_DPS_SWD_SWV, 6
.set CYDEV_DEBUGGING_DPS, CYDEV_DEBUGGING_DPS_SWD_SWV
.set CYDEV_DEBUGGING_ENABLE, 1
.set CYDEV_DEBUGGING_XRES, 0
.set CYDEV_DMA_CHANNELS_AVAILABLE, 24
.set CYDEV_ECC_ENABLE, 0
.set CYDEV_HEAP_SIZE, 0x80
.set CYDEV_INSTRUCT_CACHE_ENABLED, 1
.set CYDEV_INTR_RISING, 0x00000000
.set CYDEV_IS_EXPORTING_CODE, 0
.set CYDEV_IS_IMPORTING_CODE, 0
.set CYDEV_PROJ_TYPE, 0
.set CYDEV_PROJ_TYPE_BOOTLOADER, 1
.set CYDEV_PROJ_TYPE_LAUNCHER, 5
.set CYDEV_PROJ_TYPE_LOADABLE, 2
.set CYDEV_PROJ_TYPE_LOADABLEANDBOOTLOADER, 4
.set CYDEV_PROJ_TYPE_MULTIAPPBOOTLOADER, 3
.set CYDEV_PROJ_TYPE_STANDARD, 0
.set CYDEV_PROTECTION_ENABLE, 0
.set CYDEV_STACK_SIZE, 0x0800
.set CYDEV_USE_BUNDLED_CMSIS, 1
.set CYDEV_VARIABLE_VDDA, 0
.set CYDEV_VDDA_MV, 5000
.set CYDEV_VDDD_MV, 5000
.set CYDEV_VDDIO0_MV, 5000
.set CYDEV_VDDIO1_MV, 5000
.set CYDEV_VDDIO2_MV, 5000
.set CYDEV_VDDIO3_MV, 5000
.set CYDEV_VIO0_MV, 5000
.set CYDEV_VIO1_MV, 5000
.set CYDEV_VIO2_MV, 5000
.set CYDEV_VIO3_MV, 5000
.set CYIPBLOCK_ARM_CM3_VERSION, 0
.set CYIPBLOCK_P3_ANAIF_VERSION, 0
.set CYIPBLOCK_P3_CAN_VERSION, 0
.set CYIPBLOCK_P3_CAPSENSE_VERSION, 0
.set CYIPBLOCK_P3_COMP_VERSION, 0
.set CYIPBLOCK_P3_DECIMATOR_VERSION, 0
.set CYIPBLOCK_P3_DFB_VERSION, 0
.set CYIPBLOCK_P3_DMA_VERSION, 0
.set CYIPBLOCK_P3_DRQ_VERSION, 0
.set CYIPBLOCK_P3_DSM_VERSION, 0
.set CYIPBLOCK_P3_EMIF_VERSION, 0
.set CYIPBLOCK_P3_I2C_VERSION, 0
.set CYIPBLOCK_P3_LCD_VERSION, 0
.set CYIPBLOCK_P3_LPF_VERSION, 0
.set CYIPBLOCK_P3_OPAMP_VERSION, 0
.set CYIPBLOCK_P3_PM_VERSION, 0
.set CYIPBLOCK_P3_SCCT_VERSION, 0
.set CYIPBLOCK_P3_TIMER_VERSION, 0
.set CYIPBLOCK_P3_USB_VERSION, 0
.set CYIPBLOCK_P3_VIDAC_VERSION, 0
.set CYIPBLOCK_P3_VREF_VERSION, 0
.set CYIPBLOCK_S8_GPIO_VERSION, 0
.set CYIPBLOCK_S8_IRQ_VERSION, 0
.set CYIPBLOCK_S8_SAR_VERSION, 0
.set CYIPBLOCK_S8_SIO_VERSION, 0
.set CYIPBLOCK_S8_UDB_VERSION, 0
.set DMA_CHANNELS_USED__MASK0, 0x00000000
.set CYDEV_BOOTLOADER_ENABLE, 0
.endif
